## Documentation/devicetree/bindings/clock/samsung,exynos1280-clock.yaml
```yaml
# SPDX-License-Identifier: (GPL-2.0-only OR BSD-2-Clause)
%YAML 1.2
---
$id: http://devicetree.org/schemas/clock/samsung,exynos8895-clock.yaml#
$schema: http://devicetree.org/meta-schemas/core.yaml#

title: Samsung Exynos1280 SoC clock controller

maintainers:
  - Muhammad <thevancedgamer@mentallysanemainliners.org>
  - Chanwoo Choi <cw00.choi@samsung.com>
  - Krzysztof Kozlowski <krzk@kernel.org>

description: |
  Exynos1280 clock controller is comprised of several CMU units, generating
  clocks for different domains. Those CMU units are modeled as separate device
  tree nodes, and might depend on each other. The root clock in that root tree
  is an external clock: OSCCLK (26 MHz). This external clock must be defined
  as a fixed-rate clock in dts.

  CMU_TOP is a top-level CMU, where all base clocks are prepared using PLLs and
  dividers; all other clocks of function blocks (other CMUs) are usually
  derived from CMU_TOP.

  Each clock is assigned an identifier and client nodes can use this identifier
  to specify the clock which they consume. All clocks available for usage
  in clock consumer nodes are defined as preprocessor macros in
  'include/dt-bindings/clock/samsung,exynos1280.h' header.

properties:
  compatible:
    enum:
      - samsung,exynos1280-cmu-alive
      - samsung,exynos1280-cmu-hsi
      - samsung,exynos1280-cmu-top

  clocks:
    minItems: 1
    maxItems: 16

  clock-names:
    minItems: 1
    maxItems: 16

  "#clock-cells":
    const: 1

  reg:
    maxItems: 1

required:
  - compatible
  - clocks
  - clock-names
  - reg
  - "#clock-cells"

allOf:
  - if:
      properties:
        compatible:
          contains:
            const: samsung,exynos1280-cmu-alive

    then:
      properties:
        clocks:
          items:
            - description: Fixed reference clock (24.576 MHz)
            - description: CMU_ALIVE BUS clock (from CMU_TOP)
            - description: CMU_ALIVE TIMER clock (from CMU_TOP)

        clock-names:
          items:
            - const: oscclk_rco_alive
            - const: bus
            - const: timer

  - if:
      properties:
        compatible:
          contains:
            const: samsung,exynos1280-cmu-hsi

    then:
      properties:
        clocks:
          items:
            - description: External reference clock (26 MHz)
            - description: CMU_HSI BUS clock (from CMU_TOP)
            - description: CMU_HSI UFS clock (from CMU_TOP)

        clock-names:
          items:
            - const: oscclk
            - const: bus
            - const: ufs_embd

  - if:
      properties:
        compatible:
          contains:
            const: samsung,exynos1280-cmu-top

    then:
      properties:
        clocks:
          items:
            - description: External reference clock (26 MHz)

        clock-names:
          items:
            - const: oscclk

additionalProperties: false

examples:
  - |
    #include <dt-bindings/clock/samsung,exynos1280.h>

    cmu_alive: clock-controller@11800000 {
        compatible = "samsung,exynos1280-cmu-alive";
        reg = <0x11800000 0x8000>;
        #clock-cells = <1>;

  			clocks = <&oscclk>,
                <&cmu_top CLK_DOUT_CMU_ALIVE_BUS>;
			          clock-names = "oscclk", "bus";
    };

...
```
